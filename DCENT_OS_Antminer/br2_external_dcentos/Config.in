## DCENT_OS_Antminer/br2_external_dcentos/configs/dcentos_am3_s19jpro_aml_defconfig
```kconfig
# DCENTos Buildroot defconfig — Antminer S19j Pro Amlogic (am3-aml PIC1704).
# D-Central Technologies, Phase 4B (2026-05-15).
#
# Target: Amlogic A113D (ARM Cortex-A53 quad, aarch64).
# Chip:   BM1362 (3x126 chips per `levels.json`, BHB42801 hashboard 0x04 0x11).
# PSU:    APW12 / APW12+ class (PMBus enable + GPIO 437 rail gate).
# PIC:    PIC1704 short-form I²C voltage controller at 0x20 (CV/BB/AML
#         S19j Pro whitelist).
# Boot:   BL2 -> FIP -> U-Boot 2015.01 -> kernel 4.9.113 (no FPGA bitstream).
#
# Per-product OVERRIDE layer. Shared content lives in:
#   dcentos-common.fragment           (workspace-wide package set + identity)
#   dcentos_am3_aml_common.fragment   (aarch64 + Linaro toolchain + cpio.gz)
#
# Sibling of dcentos_am3_s21_defconfig and dcentos_am3_s19kpro_defconfig —
# same Amlogic SoC, same boot chain, only product identity + voltage
# controller path differ. PIC1704 routing is selected at runtime via
# /etc/subtype + i2cdetect 0x20 ACK.

# =============================================================================
# Per-product identity.
# =============================================================================
BR2_TARGET_GENERIC_HOSTNAME="dcentos-s19jpro-aml"
BR2_TARGET_GENERIC_ISSUE="DCENTos for S19j Pro (am3-aml PIC1704) - D-Central Technologies"

# =============================================================================
# Overlay-on-overlay — shared amlogic overlay first, am3-s19jpro-aml identity
# last. Buildroot applies overlays left-to-right; the last write wins.
# =============================================================================
BR2_ROOTFS_OVERLAY="$(BR2_EXTERNAL_DCENTOS_PATH)/board/amlogic/rootfs-overlay $(BR2_EXTERNAL_DCENTOS_PATH)/board/amlogic/am3-s19jpro-aml/rootfs-overlay"
BR2_ROOTFS_POST_BUILD_SCRIPT="$(BR2_EXTERNAL_DCENTOS_PATH)/board/amlogic/am3-s19jpro-aml/post-build.sh $(BR2_EXTERNAL_DCENTOS_PATH)/board/common/prune-runtime-research-tools.sh"
BR2_ROOTFS_POST_IMAGE_SCRIPT="$(BR2_EXTERNAL_DCENTOS_PATH)/board/amlogic/am3-s19jpro-aml/post-image.sh"
```

## DCENT_OS_Antminer/br2_external_dcentos/configs/dcentos_am3_s19kpro_defconfig
```kconfig
# DCENTos Buildroot defconfig — Antminer S19K Pro (Amlogic am3-aml NoPic).
# D-Central Technologies, 2026.
#
# Target: Amlogic A113D (ARM Cortex-A53 quad, aarch64).
# Chip:   BM1366 (3x77 chips, BHB56902 hashboard family — 0x05 0x11 EEPROM).
# PSU:    APW121215f (fw 0x76).
# Boot:   BL2 -> FIP -> U-Boot 2015.01 -> kernel 4.9.113 (no FPGA bitstream).
#
# This is the per-product OVERRIDE layer only. Shared content lives in:
#   dcentos-common.fragment           (workspace-wide package set + identity)
#   dcentos_am3_aml_common.fragment   (aarch64 + Linaro toolchain + cpio.gz)
#
# scripts/build_in_docker.sh concatenates those two fragments BEFORE this
# defconfig and feeds the merged result to `make defconfig`. So when a key
# is declared both here and upstream, the value HERE wins (later assignment
# overrides earlier one).
#
# Sibling of dcentos_am3_s21_defconfig — same Amlogic SoC, same boot chain,
# same hashboard family, only product identity differs.

# =============================================================================
# Per-product identity.
# =============================================================================
BR2_TARGET_GENERIC_HOSTNAME="dcentos-s19k"
BR2_TARGET_GENERIC_ISSUE="DCENTos for S19K Pro (am3-aml NoPic) — D-Central Technologies"

# =============================================================================
# Overlay-on-overlay — shared amlogic overlay first, am3-s19kpro identity last.
# Buildroot applies overlays left-to-right; the last write wins, so
# product-specific files (etc/dcentos-version, dcentrald.toml, board ID files)
# overwrite anything in the shared amlogic overlay.
# =============================================================================
BR2_ROOTFS_OVERLAY="$(BR2_EXTERNAL_DCENTOS_PATH)/board/amlogic/rootfs-overlay $(BR2_EXTERNAL_DCENTOS_PATH)/board/amlogic/am3-s19kpro/rootfs-overlay"
BR2_ROOTFS_POST_BUILD_SCRIPT="$(BR2_EXTERNAL_DCENTOS_PATH)/board/amlogic/am3-s19kpro/post-build.sh $(BR2_EXTERNAL_DCENTOS_PATH)/board/common/prune-runtime-research-tools.sh"
BR2_ROOTFS_POST_IMAGE_SCRIPT="$(BR2_EXTERNAL_DCENTOS_PATH)/board/amlogic/am3-s19kpro/post-image.sh"
```

## DCENT_OS_Antminer/br2_external_dcentos/configs/dcentos_am3_s21_defconfig
```kconfig
# DCENTos Buildroot defconfig — Antminer S21 (Amlogic am3-aml NoPic).
# D-Central Technologies, 2026.
#
# Target: Amlogic A113D (ARM Cortex-A53 quad, aarch64).
# Chip:   BM1368 (1x108 chips on current .135 lab unit).
# PSU:    APW12 class, PMBus enable plus GPIO 437 PSU_nEN.
# Boot:   BL2 -> FIP -> U-Boot 2015.01 -> kernel 4.9.113 (no FPGA bitstream).
#
# Per-product OVERRIDE layer. Shared content lives in:
#   dcentos-common.fragment           (workspace-wide package set + identity)
#   dcentos_am3_aml_common.fragment   (aarch64 + Linaro toolchain + cpio.gz)
#
# Sibling of dcentos_am3_s19kpro_defconfig — same Amlogic SoC, same boot
# chain, same S11board family, only
# product identity differs.

# =============================================================================
# Per-product identity.
# =============================================================================
BR2_TARGET_GENERIC_HOSTNAME="dcentos-s21"
BR2_TARGET_GENERIC_ISSUE="DCENTos for S21 (am3-aml NoPic) - D-Central Technologies"

# =============================================================================
# Overlay-on-overlay — shared amlogic overlay first, am3-s21 identity last.
# =============================================================================
BR2_ROOTFS_OVERLAY="$(BR2_EXTERNAL_DCENTOS_PATH)/board/amlogic/rootfs-overlay $(BR2_EXTERNAL_DCENTOS_PATH)/board/amlogic/am3-s21/rootfs-overlay"
BR2_ROOTFS_POST_BUILD_SCRIPT="$(BR2_EXTERNAL_DCENTOS_PATH)/board/amlogic/am3-s21/post-build.sh $(BR2_EXTERNAL_DCENTOS_PATH)/board/common/prune-runtime-research-tools.sh"
BR2_ROOTFS_POST_IMAGE_SCRIPT="$(BR2_EXTERNAL_DCENTOS_PATH)/board/amlogic/am3-s21/post-image.sh"
```

## DCENT_OS_Antminer/br2_external_dcentos/configs/dcentos_am3_t21_defconfig
```kconfig
# DCENTos Buildroot defconfig — Antminer T21 (am3-aml NoPic).
# D-Central Technologies, Phase 4B (2026-05-15).
#
# Target: Amlogic A113D (ARM Cortex-A53 quad, aarch64).
# Chip:   BM1368 (3x76 chips; T21 is the lower-tier S21 sibling).
# PSU:    APW12 class, PMBus enable plus GPIO 437 PSU_nEN.
# Voltage: NoPic (TAS5782M audio-DAC, kernel-managed; S21 lineage).
# Boot:   BL2 -> FIP -> U-Boot 2015.01 -> kernel 4.9.113 (no FPGA bitstream).
#
# Per-product OVERRIDE layer. Shared content lives in:
#   dcentos-common.fragment           (workspace-wide package set + identity)
#   dcentos_am3_aml_common.fragment   (aarch64 + Linaro toolchain + cpio.gz)
#
# Sibling of dcentos_am3_s21_defconfig — same Amlogic SoC, same boot
# chain, same NoPic architecture, different per-chain chip count.

# =============================================================================
# Per-product identity.
# =============================================================================
BR2_TARGET_GENERIC_HOSTNAME="dcentos-t21"
BR2_TARGET_GENERIC_ISSUE="DCENTos for T21 (am3-aml NoPic) - D-Central Technologies"

# =============================================================================
# Overlay-on-overlay — shared amlogic overlay first, am3-t21 identity last.
# =============================================================================
BR2_ROOTFS_OVERLAY="$(BR2_EXTERNAL_DCENTOS_PATH)/board/amlogic/rootfs-overlay $(BR2_EXTERNAL_DCENTOS_PATH)/board/amlogic/am3-t21/rootfs-overlay"
BR2_ROOTFS_POST_BUILD_SCRIPT="$(BR2_EXTERNAL_DCENTOS_PATH)/board/amlogic/am3-t21/post-build.sh"
BR2_ROOTFS_POST_IMAGE_SCRIPT="$(BR2_EXTERNAL_DCENTOS_PATH)/board/amlogic/am3-t21/post-image.sh"
```
