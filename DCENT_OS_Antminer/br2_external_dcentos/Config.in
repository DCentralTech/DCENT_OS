## DCENT_OS_Antminer/br2_external_dcentos/configs/dcentos_cv1835_s19jpro_defconfig
```kconfig
# DCENTos Buildroot defconfig — Antminer S19j Pro Cvitek CV1835 (cv1835-s19jpro).
# D-Central Technologies, 2026.
#
# Status: runtime-only / no fleet unit. SD-card boot evidence required before
# this defconfig can be promoted from `runtime-only` to `supported`.
# See DCENT_OS_Antminer/br2_external_dcentos/board/cvitek/cv1835-s19jpro/README.md
# for the promotion criteria checklist.
#
# Target:  Cvitek CV1835 dual-core Cortex-A53 (ARM64) @ 1 GHz, 512 MB DDR3.
#          ARM32 userspace (`armhf`, glibc 2.19) runs via CONFIG_COMPAT.
#          See `S19J_PRO_PORTING_PLAN.md` §8 + RE2 BOOT_CHAIN_ANALYSIS.md.
# ASIC:    BM1362 on BHB42xxx hashboards (4 chains, 126 chips/chain).
# PSU:     APW12 / APW12+ (I2C 0x10).
# Boot:    eMMC (mmcblk0p1 = u-boot-cv183x.bin, p2 = kernel, p3 = rootfs,
#          p4 = sig.bin/DTB, p5 = /config, p6 = /tmp/miner, p7 = /nvdata).
#
# =============================================================================
# KERNEL VERSION (W11.11 — RE2 S19J_PRO_PORTING_PLAN.md §8 evidence):
# =============================================================================
# Stock CV1835 S19j Pro carriers ship **Linux 4.9.38-tag- (Linaro LSK
# tree)** with Cvitek cv1835 platform patches. RE2 evidence:
#   - S19J_PRO_PORTING_PLAN.md:280  "Version: Linux 4.9.38-tag-
#                                    (Linaro LSK tree)"
#   - S19J_PRO_PORTING_PLAN.md:281  "Arch: ARM64 (aarch64), SMP PREEMPT,
#                                    4K pages"
#   - S19J_PRO_PORTING_PLAN.md:282  "Compiler: Linaro GCC 6.3.1 20170404"
#   - S19J_PRO_PORTING_PLAN.md:284  "Base: linux-linaro-stable with
#                                    Cvitek cv1835 platform patches"
#   - S19J_PRO_PORTING_PLAN.md:286  "Userspace: ARM 32-bit (armhf,
#                                    glibc 2.19) via CONFIG_COMPAT"
#
# DCENT_OS does NOT compile its own CV1835 kernel — Buildroot here
# builds rootfs + toolchain (Linaro 7.2 ARM32 hard-float) only. At
# runtime the active kernel is the stock Cvitek 4.9.38 ARM64 image
# already on eMMC (`mmcblk0p2`). DCENT_OS sysupgrade NEVER overwrites
# the kernel slot — (eMMC =
# single-slot kernel + rootfs; bootcount > 3 → /config/factory_kernel.bin
# fallback).
#
# This means our ARM32 userspace runs as a 32-bit-on-64-bit guest
# courtesy of the stock kernel's CONFIG_COMPAT. We rely on the stock
# kernel having the necessary COMPAT flags set — the linux-config
# fragment shipped at:
#   board/cvitek/cv1835-s19jpro/linux-config-fragment.cfg
# documents the expected stock-kernel COMPAT surface and is wired via
# BR2_LINUX_KERNEL_CONFIG_FRAGMENT_FILES below for the day Buildroot
# does build a CV1835 kernel (currently NOT enabled — see
# README_KERNEL_VERSIONS.md). The fragment lists CONFIG_COMPAT=y +
# CONFIG_COMPAT_BINFMT_ELF=y + CONFIG_COMPAT_OLD_SIGACTION=y per
# S19J_PRO_PORTING_PLAN.md:301 ("CONFIG_COMPAT=y // ARM32 userspace
# on ARM64 kernel").
#
# DECISION ( #2): NO proprietary kernel modules.
#   - We do NOT ship cv183x_base.ko, cv183x_pwm.ko, or uart_trans.ko.
#   - DevmemUart (W10.3) handles ASIC UART via /dev/mem mmap.
#   - PWM goes through upstream sysfs pwmchip0 (the kernel needs CONFIG_PWM
#     plus the in-tree CV1835 PWM driver if available, or we fall back to
#     bit-banging via DevmemUart-style mmap of 0x03001xxx).
#   - I2C goes through /dev/i2c-* (CONFIG_I2C_CHARDEV).
#
# This is a TRADEOFF: clean-room and ABI-stable, but fan + I2C bring-up are
# hardware-gated until live confirmation. If upstream 4.9.38 is missing the
# in-tree CV1835 drivers, the bring-up plan is to extend DevmemUart with
# PWM and I2C IP register bases (mirrors the W10.3 UART pattern).
# =============================================================================

# =============================================================================
# Architecture - CV1835 / Cortex-A7 / armv7.
# =============================================================================
BR2_arm=y
BR2_cortex_a7=y
BR2_ARM_ENABLE_NEON=y
BR2_ARM_ENABLE_VFP=y
BR2_ARM_FPU_VFPV4=y

# =============================================================================
# Toolchain - keep arm-linux-gnueabihf userspace compatible with CV1835's
# 4.9.38 kernel ABI. Same Linaro release used by am3-bb (BeagleBone) since
# both are armv7 with hard-float.
# =============================================================================
BR2_TOOLCHAIN_EXTERNAL=y
BR2_TOOLCHAIN_EXTERNAL_CUSTOM=y
BR2_TOOLCHAIN_EXTERNAL_DOWNLOAD=y
BR2_TOOLCHAIN_EXTERNAL_URL="https://releases.linaro.org/components/toolchain/binaries/7.2-2017.11/arm-linux-gnueabihf/gcc-linaro-7.2.1-2017.11-x86_64_arm-linux-gnueabihf.tar.xz"
BR2_TOOLCHAIN_EXTERNAL_CUSTOM_PREFIX="arm-linux-gnueabihf"
BR2_TOOLCHAIN_EXTERNAL_GCC_7=y
BR2_TOOLCHAIN_EXTERNAL_HEADERS_4_10=y
BR2_TOOLCHAIN_EXTERNAL_CUSTOM_GLIBC=y
BR2_TOOLCHAIN_EXTERNAL_CXX=y

# =============================================================================
# Rootfs format - eMMC primary partition holds an ext4 rootfs (mmcblk0p3),
# but we ALSO build a cpio.gz so the BMU-style update flow can dd a packed
# image into mmcblk0p3 directly without mkfs.ext4 on the live unit.
# =============================================================================
BR2_TARGET_ROOTFS_CPIO=y
BR2_TARGET_ROOTFS_CPIO_GZIP=y
BR2_TARGET_ROOTFS_EXT2=y
BR2_TARGET_ROOTFS_EXT2_4=y
BR2_TARGET_ROOTFS_EXT2_SIZE="32M"

# =============================================================================
# Per-product identity.
# =============================================================================
BR2_TARGET_GENERIC_HOSTNAME="dcentos-cv1835"
BR2_TARGET_GENERIC_ISSUE="DCENTos for S19j Pro Cvitek CV1835 (cv1835-s19jpro) - runtime-only"

# =============================================================================
# Overlay-on-overlay: reuse the serial-mining init/dashboard layer (amlogic
# overlay also covers DevmemUart-driven serial chains and ships the
# dcent_toolbox compatible /usr/share/dcentos-dashboard layout), then stamp
# CV1835 identity on top.
# =============================================================================
BR2_ROOTFS_OVERLAY="$(BR2_EXTERNAL_DCENTOS_PATH)/board/amlogic/rootfs-overlay $(BR2_EXTERNAL_DCENTOS_PATH)/board/cvitek/cv1835-s19jpro/rootfs-overlay"
BR2_ROOTFS_POST_BUILD_SCRIPT="$(BR2_EXTERNAL_DCENTOS_PATH)/board/cvitek/cv1835-s19jpro/post-build.sh $(BR2_EXTERNAL_DCENTOS_PATH)/board/common/prune-runtime-research-tools.sh"
BR2_ROOTFS_POST_IMAGE_SCRIPT="$(BR2_EXTERNAL_DCENTOS_PATH)/board/cvitek/cv1835-s19jpro/post-image.sh"

# =============================================================================
# CV1835-specific packages.
# =============================================================================

# libubootenv-tools: REQUIRED — fw_setenv is how userspace clears
# dcent_boot_count after dcentrald reaches steady-state mining (see
# uboot-bootcmd.txt). Without this, the boot-count recovery model is
# inert (can never succeed past 3 boots) and every reboot would
# eventually trigger factory restore. Same lesson as
# .
BR2_PACKAGE_LIBUBOOTENV=y
BR2_PACKAGE_LIBUBOOTENV_TOOLS=y

# Defense-in-depth firewall (mirrors am3-bb hardening; CV1835 doesn't ship
# the daemons:22322 privesc, but iptables is cheap and stays consistent).
BR2_PACKAGE_IPTABLES=y

# Lighttpd: dashboard SPA + REST API reverse proxy on :80 (parity with
# zynq + amlogic + am3-bb boards; dcentrald owns :8080 + :4028).
BR2_PACKAGE_LIGHTTPD=y
BR2_PACKAGE_LIGHTTPD_OPENSSL=y

# Dropbear SSH (provided by amlogic overlay default selection but pinned
# here for clarity).
BR2_PACKAGE_DROPBEAR=y

# eMMC tooling: mmc-utils for `mmc part`, sfdisk-equivalent partition
# inspection during sysupgrade preflight.
BR2_PACKAGE_MMC_UTILS=y

# Raw I2C utilities are excluded; dcentrald owns PIC1704/APW12/LM75A buses.
# probing (parity with am2 / am3-bb / amlogic).
# BR2_PACKAGE_I2C_TOOLS is not set

# =============================================================================
# Kernel build (W11.11 — FORWARD-LOOKING, NOT WIRED).
# =============================================================================
# Today: BR2_LINUX_KERNEL is NOT enabled. CV1835 reuses the stock 4.9.38
# Linaro LSK + Cvitek-patched kernel already on `mmcblk0p2`. Buildroot
# only produces the rootfs + toolchain.
#
# IF we later enable a Buildroot kernel build for CV1835 (e.g. clean-room
# kernel rebuild for FOSS hardening), uncomment the block below. The
# linux-config-fragment.cfg in the board dir documents the COMPAT surface
# the stock kernel already has and the rebuilt kernel must keep, per
# RE2 S19J_PRO_PORTING_PLAN.md §8 line 301.
#
# Buildroot 2024.x supports kernels back to 4.9 LTS; exact 4.9.38 isn't
# offered as a stock choice, so the closest-stable LTS series tag is the
# right pick (4.9.337+ as of Buildroot 2024.02 LTS). CONFIG_COMPAT must
# stay y for ARM32 userspace on the ARM64 kernel.
#
# BR2_LINUX_KERNEL=y
# BR2_LINUX_KERNEL_CUSTOM_VERSION=y
# BR2_LINUX_KERNEL_CUSTOM_VERSION_VALUE="4.9.337"
# BR2_LINUX_KERNEL_DEFCONFIG="defconfig"
# BR2_LINUX_KERNEL_CONFIG_FRAGMENT_FILES="$(BR2_EXTERNAL_DCENTOS_PATH)/board/cvitek/cv1835-s19jpro/linux-config-fragment.cfg"
# BR2_LINUX_KERNEL_IMAGE=y
# =============================================================================
```

## DCENT_OS_Antminer/br2_external_dcentos/configs/dcentos_s9_defconfig
```kconfig
# DCENTos Hacker Shell - Buildroot defconfig for Antminer S9 (Zynq 7010).
# D-Central Technologies, 2026.
#
# Target: Xilinx Zynq-7010 (ARM Cortex-A9, dual core).
# Purpose: Research firmware with SSH + diagnostic tools.
# Output: rootfs.squashfs (BraiinsOS UBI path) + ramdisk.itb (stock NAND).
#
# Per-product OVERRIDE layer. Shared content lives in:
#   dcentos-common.fragment   (workspace-wide package set + identity)
#
# scripts/build_in_docker.sh concatenates that fragment BEFORE this defconfig
# and feeds the merged result to `make defconfig`. So when a key is declared
# both here and upstream, the value HERE wins (later assignment overrides
# earlier one).
#
# S9 is the only DCENT_OS product on Zynq Cortex-A9 + squashfs at the moment
# (am2-s19jpro is also Zynq Cortex-A9 but on a different hashboard family).
# The arch + filesystem block is therefore inline rather than promoted to a
# shared "armv7 common" fragment. Promote on demand if a third Cortex-A9 /
# squashfs product joins the matrix.

# =============================================================================
# Target Architecture: ARM Cortex-A9 (Zynq-7010).
# =============================================================================
BR2_arm=y
BR2_cortex_a9=y
BR2_ARM_ENABLE_NEON=y
BR2_ARM_ENABLE_VFP=y
BR2_ARM_FPU_VFPV3D16=y

# =============================================================================
# Toolchain: Linaro GCC 7.2.1-2017.11 (matches BraiinsOS 4.4.0-xilinx kernel).
# =============================================================================
BR2_TOOLCHAIN_EXTERNAL=y
BR2_TOOLCHAIN_EXTERNAL_CUSTOM=y
BR2_TOOLCHAIN_EXTERNAL_DOWNLOAD=y
BR2_TOOLCHAIN_EXTERNAL_URL="https://releases.linaro.org/components/toolchain/binaries/7.2-2017.11/arm-linux-gnueabihf/gcc-linaro-7.2.1-2017.11-x86_64_arm-linux-gnueabihf.tar.xz"
BR2_TOOLCHAIN_EXTERNAL_CUSTOM_PREFIX="arm-linux-gnueabihf"
BR2_TOOLCHAIN_EXTERNAL_GCC_7=y
BR2_TOOLCHAIN_EXTERNAL_HEADERS_4_10=y
BR2_TOOLCHAIN_EXTERNAL_CUSTOM_GLIBC=y
BR2_TOOLCHAIN_EXTERNAL_CXX=y
BR2_TOOLCHAIN_EXTERNAL_FORTRAN=y
BR2_TOOLCHAIN_EXTERNAL_OPENMP=y

# =============================================================================
# Filesystem: DUAL OUTPUT — squashfs (for BraiinsOS UBI) + ext4 (stock NAND).
#
# Path 1 (PRIMARY): BraiinsOS-installed S9 — replace squashfs in UBI mtd7.
# Path 2 (FALLBACK): Stock S9 — wrap rootfs.ext2.gz in FIT image (ramdisk.itb).
# =============================================================================
BR2_TARGET_ROOTFS_SQUASHFS=y
BR2_TARGET_ROOTFS_SQUASHFS_BS_1024K=y
BR2_TARGET_ROOTFS_SQUASHFS4_XZ=y
BR2_TARGET_ROOTFS_SQUASHFS_EXTREME_COMP=y
# Drop eudev's desktop hardware database (~1.34 MiB) — no miner uses it; udevd
# keeps running. Parity with dcentos_am2_s19jpro_defconfig.
# BR2_PACKAGE_EUDEV_ENABLE_HWDB is not set
BR2_TARGET_ROOTFS_EXT2=y
BR2_TARGET_ROOTFS_EXT2_4=y
BR2_TARGET_ROOTFS_EXT2_SIZE="96M"

# =============================================================================
# Per-product identity.
# =============================================================================
BR2_TARGET_GENERIC_HOSTNAME="dcentos"
BR2_TARGET_GENERIC_ISSUE="DCENTos Hacker Shell v0.1 — D-Central Technologies"

# =============================================================================
# Overlay and Scripts — single overlay (no overlay-on-overlay; S9 ships its
# zynq overlay direct).
# =============================================================================
BR2_ROOTFS_OVERLAY="$(BR2_EXTERNAL_DCENTOS_PATH)/board/zynq/rootfs-overlay"
BR2_ROOTFS_POST_BUILD_SCRIPT="$(BR2_EXTERNAL_DCENTOS_PATH)/board/zynq/post-build.sh $(BR2_EXTERNAL_DCENTOS_PATH)/board/common/prune-runtime-research-tools.sh"
BR2_ROOTFS_POST_IMAGE_SCRIPT="$(BR2_EXTERNAL_DCENTOS_PATH)/board/zynq/post-image-ramdisk.sh"

# =============================================================================
# S9-specific BusyBox config — zynq-tuned (CONFIG_DEVMEM=y for FPGA register
# poking, plus a few S9-only applets). Amlogic / am3-bb use the Buildroot
# default busybox config and therefore do NOT inherit this line.
# =============================================================================
BR2_PACKAGE_BUSYBOX_CONFIG="$(BR2_EXTERNAL_DCENTOS_PATH)/board/zynq/busybox.config"
```

## DCENT_OS_Antminer/br2_external_dcentos/packages/dcentos-tools/Config.in
```kconfig
config BR2_PACKAGE_DCENTOS_TOOLS
	bool "dcentos-tools"
	depends on BR2_PACKAGE_PYTHON3
	help
	  DCENT_OS Python dashboard and local MCP API adapters.

	  Standalone raw-hardware research tools are intentionally not installed
	  in normal runtime images. They must eventually be delivered through an
	  explicit repair environment with exclusive hardware ownership.

	  https://d-central.tech/
```

## DCENT_OS_Antminer/br2_external_dcentos/packages/seed-entropy/Config.in
```kconfig
config BR2_PACKAGE_SEED_ENTROPY
	bool "seed-entropy"
	help
	  Native saved-seed lifecycle helper. It atomically consumes a
	  single-use persistent seed, mixes it through the kernel write path,
	  credits it separately with RNDADDENTROPY, and durably rotates a
	  replacement without permitting replay or same-boot circular credit.
	  Transactional boot-epoch and SHA-256 markers bind provenance to the
	  exact generated seed until a later boot.

	  Its separate shutdown initializer only creates the first seed after
	  an in-process CRNG readiness proof. Markerless seeds from older
	  releases are mixed without credit and regenerated. Unsafe paths,
	  metadata, device identity, partial lifecycle states, and concurrent
	  invocations fail closed.

	  https://d-central.tech/
```
